// ergoTravelLight_right.overlay

// Include dtsi file with the matrix and row GPIO definitons.
#include "ergoTravelLight.dtsi"

// The matrix transform for this board is 7 columns over because the left half is 7 columns wide according to the matrix.
&default_transform { 
    col-offset = <7>;
};

// Column GPIOdefinitions.
&kscan0 {
    col-gpios
        = <&pro_micro 10 GPIO_ACTIVE_HIGH> // col6 in the schematic
        , <&pro_micro 16 GPIO_ACTIVE_HIGH> // col5 in the schematic
        , <&pro_micro 14 GPIO_ACTIVE_HIGH> // col4 in the schematic
        , <&pro_micro 15 GPIO_ACTIVE_HIGH> // col3 in the schematic
        , <&pro_micro 18 GPIO_ACTIVE_HIGH> // col2 in the schematic
        , <&pro_micro 19 GPIO_ACTIVE_HIGH> // col1 in the schematic
        , <&pro_micro 20 GPIO_ACTIVE_HIGH> // col0 in the schematic
        ;
};