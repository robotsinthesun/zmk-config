## Kconfig
```kconfig
# Module Kconfig (required for Zephyr module registration)
menu "ergotravellight module"
endmenu
```

## boards/shields/ergotravellight_left/Kconfig.defconfig
```kconfig
if SHIELD_ERGO_TRAVEL_LIGHT_LEFT

config ZMK_KEYBOARD_NAME
    default "Ergo Travel"

config ZMK_SPLIT
    default y

config ZMK_SPLIT_BLE_ROLE_CENTRAL
    default y

endif
```

## boards/shields/ergotravellight_left/Kconfig.shield
```kconfig
config SHIELD_ERGO_TRAVEL_LIGHT_LEFT
    def_bool $(shields_list_contains,ergotravellight_left)
```

## boards/shields/ergotravellight_right/Kconfig.defconfig
```kconfig
if SHIELD_ERGO_TRAVEL_LIGHT_RIGHT

config ZMK_KEYBOARD_NAME
    default "Ergo Travel Lite"

config ZMK_SPLIT
    default y

endif
```

## boards/shields/ergotravellight_right/Kconfig.shield
```kconfig
config SHIELD_ERGO_TRAVEL_LIGHT_RIGHT
    def_bool $(shields_list_contains,ergotravellight_right)
```

## config/boards/shields/ergoTravelLight/Kconfig.shield
```kconfig
config SHIELD_ERGO_TRAVEL_LIGHT_LEFT
    def_bool $(shields_list_contains,ergo_travel_light_left)

config SHIELD_ERGO_TRAVEL_LIGHT_RIGHT
    def_bool $(shields_list_contains,ergo_travel_light_right)
```
